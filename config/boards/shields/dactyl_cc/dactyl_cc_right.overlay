// dactyl_cc_right.overlay

#include "dactyl_cc.dtsi"

&default_transform { // The matrix transform for this board is 7 columns over because the left half is 7 columns wide according to the matrix.
    col-offset = <7>;
};

&kscan0 {
    col-gpios
        = <&gpio0 17 GPIO_ACTIVE_HIGH> // col7  in the schematic
        , <&gpio0 20 GPIO_ACTIVE_HIGH> // col8  in the schematic
        , <&gpio0 22 GPIO_ACTIVE_HIGH> // col9  in the schematic
        , <&gpio0 24 GPIO_ACTIVE_HIGH> // col10 in the schematic
        , <&gpio1 0  GPIO_ACTIVE_HIGH> // col11 in the schematic
        , <&gpio0 11 GPIO_ACTIVE_HIGH> // col12 in the schematic
        , <&gpio1 4  GPIO_ACTIVE_HIGH> // col13 in the schematic
        ;
};
